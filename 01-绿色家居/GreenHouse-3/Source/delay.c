/*********************************************************************************************
* 文件：delay.c
* 作者：Meixin 2017.09.27
* 说明：延时驱动代码
* 修改：
* 注释：
*********************************************************************************************/

/*********************************************************************************************
* 头文件
*********************************************************************************************/
#include "delay.h"

/*********************************************************************************************
* 名称：hal_wait(u8 wait)
* 功能：硬件毫秒延时函数
* 参数：wait——延时时间（wait < 255）
* 返回：无
* 修改：
* 注释：CC2530系统固件库系统的精确毫秒延时函数
*********************************************************************************************/
void hal_wait(u8 wait)
{
  unsigned long largeWait;                                      //定义硬件计数临时参数

  if(wait == 0) return;                                         //如果延时参数为0,则跳出                        
  largeWait = ((u16) (wait << 7));                              //将数据扩大64倍
  largeWait += 114*wait;                                        //将延时数据扩大114倍并求和      

  largeWait = (largeWait >> CLKSPD);                            //根据系统时钟频率对延时进行放缩
  while(largeWait--);                                           //等待延时自减完成
}

/*********************************************************************************************
* 名称：delay_ss()
* 功能：在延时毫秒的基础上延时秒
* 参数：times——延时时间
* 返回：无
* 修改：
* 注释：延时为990,用于抵消while函数的指令周期
*********************************************************************************************/
void delay_ss(u16 times)
{
  while(times --){
    delay_ms(990);                                              //延时1S
  }
}

/*********************************************************************************************
* 名称：delay_ms()
* 功能：再硬件延时上延时大于255的毫秒延时
* 参数：times——延时时间
* 返回：无
* 修改：
* 注释：
*********************************************************************************************/
void delay_ms(u16 times)
{
  u16 i,j;                                                      //定于临时参数
  i = times / 250;                                              //获取要延时时长的250ms倍数部分
  j = times % 250;                                              //获取要延时时长的250ms余数部分
  while(i --) hal_wait(250);                                     //延时250毫秒
  hal_wait(j);                                                   //延时剩余部分        
}

/*********************************************************************************************
* 名称：delay_us()
* 功能：估算的微秒延时函数
* 参数：times——延时时间
* 返回：无
* 修改：
* 注释：
*********************************************************************************************/
void delay_us(u16 times)
{
  while (times--){
    asm("NOP");													//汇编指令空操作
    asm("NOP");
    asm("NOP");
  }
}

/*********************************************************************************************
* 名称：void delay_pwm(unsigned int t)
* 功能：延时
* 参数：无
* 返回：无
* 修改：
* 注释：
*********************************************************************************************/
void delay_pwm(unsigned int t) 
{ 
  while(t--); 
}