/*********************************************************************************************
* 文件：at-uart.c
* 作者：Xuzhy 2018.5.16
* 说明：节点AT指令串口初始化
* 修改：
* 注释：
*********************************************************************************************/

/*********************************************************************************************
* 头文件
*********************************************************************************************/
#include <iocc2530.h>
#include <stdio.h>
#include "hal_mcu.h"
#include "uart.h"

/*********************************************************************************************
* 宏定义
*********************************************************************************************/

/*********************************************************************************************
* 函数原型说明
*********************************************************************************************/
extern void UART_BuadCount(double* baud,char* baud_e,char* baud_m);
static void (*_input)(char ch);
/*********************************************************************************************
* 名称：at_uart_init()
* 功能：节点AT指令串口初始化
* 参数：
* 返回：
* 修改：
* 注释：
******************************************
*    CC253O 32M系统时钟波特率参数表      *
*----------------------------------------*
*  波特率  UxBAUD         UxGCRM         *
*  240     59             6              *
*  4800    59             7              *
*  9600    59             8              *
*  14400   216            8              *
*  19200   59             9              *
*  28800   216            9              *
*  38400   59             10             *
*  57600   216            10             *
*  76800   59             11             *
*  115200  216            11             *
*  23040   216            12             *
******************************************
*********************************************************************************************/
void uart_init(double baud)
{   
	char baud_e,baud_m;
	
    P1SEL |= ((1<<4)|(1<<5));									//选择IO功能为外设
    P1DIR &= ~(1<<5);											//设置为输入
    P1DIR |= (1<<4);											//设置为输出
    PERCFG |= (1<<0);											//选择复用到位置2
	
	U0CSR = 0xC0;                   							//设置为UART模式,而且使能接受器
	UART_BuadCount(&baud,&baud_e,&baud_m);						//计算波特率
	U0GCR = baud_e;                  
	U0BAUD = baud_m;                  							//设置波特率
    
	URX0IE = 1;													//串口接收中断使能
	EA = 1;														//开总中断
}
/*********************************************************************************************
* 名称：at_uart_write()
* 功能：
* 参数：
* 返回：
* 修改：
* 注释：
*********************************************************************************************/
void uart_write(char ch)
{
    U0DBUF = ch;                                                //将要发送的数据填入发送缓存寄存器
    while((U0CSR&0x02) == 0);                                   //等待数据发送完成
    U0CSR &= ~0x02;
}
/*********************************************************************************************
* 名称：auart_write_buf()
* 功能：
* 参数：
* 返回：
* 修改：
* 注释：
*********************************************************************************************/
void uart_write_buf(char *buf, uint8 len)
{
    for (uint8 i=0; i<len; i++)
    {
        uart_write(buf[i]);
    }
}
/*********************************************************************************************
* 名称：at_uart_set_input_call()
* 功能：节点AT指令串口读数据
* 参数：
* 返回：
* 修改：
* 注释：
*********************************************************************************************/
void uart_set_input_call(void (*c)(char ch))
{
    _input = c;
}
/*********************************************************************************************
* 名称：HAL_ISR_FUNCTION()
* 功能：节点AT指令串口中断处理
* 参数：
* 返回：
* 修改：
* 注释：
*********************************************************************************************/
HAL_ISR_FUNCTION(halUart0TxIsr, URX0_VECTOR)
{
    char ch;
    ch = U0DBUF;
    if (_input != NULL)
    {
        _input(ch);
    }
}