/*********************************************************************************************
* 文件：ld3320.c
* 作者：zonesion
* 说明：ld3320驱动程序
* 修改：Chenkm 2017.01.04 增加了注释
* 注释：
*********************************************************************************************/
/*********************************************************************************************
* 头文件
*********************************************************************************************/
#include "ld3320.h"
#include "string.h"
#include "delay.h"

static unsigned char rx_buf = 0;
char* cmd[13] = {"yu liu zhi ling",                             //预留指令
                 "da kai tai deng",                             //打开台灯
                 "guan bi tai deng",                            //关闭台灯
                 "da kai chuang lian",                          //打开窗帘
                 "guan bi chuang lian",                         //关闭窗帘
                 "da kai feng shan",                            //打开风扇
                 "guan bi feng shan",                           //关闭风扇
                 "da kai kong tiao",                            //打开空调
                 "guan bi kong tiao",                           //关闭空调
                 "da kai jia shi qi",                           //打开加湿器
                 "guan bi jia shi qi",                          //关闭加湿器
                 "zi dong mo shi",                              //自动模式
                 "shou dong mo shi",                            //手动模式
                 //"que ren",                                     //确认指令
};
/*********************************************************************************************
* 名称：uart0_init(unsigned char StopBits,unsigned char Parity)
* 功能：串口0初始化
* 参数：无
* 返回：无
* 修改：
* 注释：
****************************************** 
*    CC253O 32M系统时钟波特率参数表      * 
*----------------------------------------* 
*  波特率  UxBAUD         UxGCRM         * 
*  240     59             6              * 
*  4800    59             7              * 
*  9600    59             8              * 
*  14400   216            8              * 
*  19200   59             9              * 
*  28800   216            9              * 
*  38400   59             10             * 
*  57600   216            10             * 
*  76800   59             11             * 
*  115200  216            11             * 
*  23040   216            12             * 
****************************************** 
*********************************************************************************************/
void uart0_init(unsigned char StopBits,unsigned char Parity)
{
  P0SEL |=  0x0C;                                               //初始化UART0端口
  PERCFG&= ~0x01;                                               //选择UART0为可选位置一
  P2DIR &= ~0xC0;                                               //P0优先作为串口0
  U0CSR = 0xC0;                                                 //设置为UART模式,而且使能接受器
  
  U0GCR = 0x8;                  
  U0BAUD = 59;                                                  //波特率设置为9600
  
  U0UCR = 2;
  URX0IE = 1;                                                   // 使能接收中断
}

/*********************************************************************************************
* 名称：uart_send_char()
* 功能：串口发送字节函数
* 参数：无
* 返回：无
* 修改：
* 注释：
*********************************************************************************************/
void uart_send_char(unsigned char ch)
{
  
  U0DBUF = ch;                                                  //将要发送的数据填入发送缓存寄存器
  while((U0CSR&0x02) == 0);                                     
  U0CSR &= ~0x02;                                             //发送完成后将数据清零
}

/*********************************************************************************************
* 名称：ld3320_init()
* 功能：ld3320初始化
* 参数：
* 返回：
* 修改：
* 注释：
*********************************************************************************************/
void ld3320_init()
{
  char i = 0;
  uart0_init(0,0); 
  ld3320_clean();
  delay_ms(200);
  ld3320_reload();
  delay_ms(200);
  for (i=0; i<13; i++){
    ld3320_add(cmd[i]);
    delay_ms(150);
  }
  delay_ms(200);
  ld3320_reload();
}
/*********************************************************************************************
* 名称：ld3320_add()
* 功能：添加一条识别语句
* 参数：s -- 数组名
* 返回：
* 修改：
* 注释：两次调用需至少隔0.1S,且调用ld3320_reload函数后语句才会生效，数据异常时模块绿灯会闪烁
*********************************************************************************************/
void ld3320_add(char *s)
{
  int i;
  int len = strlen(s);
  uart_send_char('{');
  uart_send_char('a');
  uart_send_char('0');
  for (i=0; i<len; i++){
    uart_send_char(s[i]);
  }
  uart_send_char('}');
}

/*********************************************************************************************
* 名称：ld3320_addrs()
* 功能：添加一条识别语句并返回字符串
* 参数：s -- 添加语句 r -- 返回语句
* 返回：
* 修改：
* 注释：两次调用需至少隔0.1S,且调用ld3320_reload函数后语句才会生效，数据异常时模块绿灯会闪烁
*********************************************************************************************/
void ld3320_addrs(char *s,char *r)
{
  int i;
  int len = strlen(s);
  uart_send_char('{');
  uart_send_char('a');
  uart_send_char('0');
  for (i=0; i<len; i++){
    uart_send_char(s[i]);
  }
  uart_send_char('|');
  uart_send_char('s');
  uart_send_char('0');
  len = strlen(r);
  for (i=0; i<len; i++){
    uart_send_char(s[i]);
  }
  uart_send_char('}');
}

/*********************************************************************************************
* 名称：ld3320_addrx()
* 功能：添加一条识别语句并返回一字节16进制数
* 参数：s -- 数组名 x -- 返回数
* 返回：
* 修改：
* 注释：两次调用需至少隔0.1S,且调用ld3320_reload函数后语句才会生效，数据异常时模块绿灯会闪烁
*********************************************************************************************/
void ld3320_addrx(char *s,unsigned char x)
{
  int i;
  int len = strlen(s);
  uart_send_char('{');
  uart_send_char('a');
  uart_send_char('0');
  for (i=0; i<len; i++){
    uart_send_char(s[i]);
  }
  uart_send_char('|');
  uart_send_char('x');
  uart_send_char('0');
  uart_send_char(x);
  uart_send_char('}');
}

/*********************************************************************************************
* 名称：ld3320_clean()
* 功能：清除所有语句列表
* 参数：
* 返回：
* 修改：
* 注释：清除语句列表后模块绿灯会闪烁
*********************************************************************************************/
void ld3320_clean(void)
{
  uart_send_char('{');
  uart_send_char('c');
  uart_send_char('0');
  uart_send_char('}');
}

/*********************************************************************************************
* 名称：ld3320_reload()
* 功能：重新加载语句列表
* 参数：
* 返回：
* 修改：
* 注释：添加语句后需重新加载语句列表
*********************************************************************************************/
void ld3320_reload(void)
{
  uart_send_char('{');
  uart_send_char('l');
  uart_send_char('0');
  uart_send_char('}');
}

/*********************************************************************************************
* 名称：ld3320_debug()
* 功能：开启/关闭调试模式
* 参数：
* 返回：
* 修改：
* 注释：添加语句后需重新加载语句列表
*********************************************************************************************/
void ld3320_debug(unsigned char cmd)
{
  uart_send_char('{');
  uart_send_char('d');
  if(cmd == 1)
    uart_send_char('1');
  else
    uart_send_char('0');
  uart_send_char('}');
}

/*********************************************************************************************
* 名称：ld3320_read
* 功能：
* 参数：
* 返回：
* 修改：
* 注释：
*********************************************************************************************/
char ld3320_read(void)
{
  char x = rx_buf;
  rx_buf = 0;
  return x;
}

#pragma vector=URX0_VECTOR  
__interrupt void UART0_ISR(void)  
{  
  URX0IF = 0;                                         // 清除接收中断标志  
  rx_buf = U0DBUF;                                    // 填充缓冲区  
}